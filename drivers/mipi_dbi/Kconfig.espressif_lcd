## drivers/mipi_dbi/Kconfig.espressif_lcd
```kconfig
config MIPI_DBI_ESPRESSIF_LCD
	bool "MIPI DBI driver for ESP LCD peripheral"
	default y
	depends on DT_HAS_ESPRESSIF_ESP_MIPI_DBI_LCD_ENABLED && (SOC_ESP32S3 || SOC_ESP32P4)
	help
	  Enable support for MIPI DBI driver for ESP32-S3 or ESP32-P4 boards LCD peripheral.
```

## dts/bindings/mipi-dbi/espressif,esp32-lcd-cam-mipi-dbi.yaml
```yaml
# Copyright (c) 2025 Chen Xingyu <hi@xingrz.me>
# SPDX-License-Identifier: Apache-2.0

description: ESP32 LCD-CAM display interface

compatible: "espressif,esp32-lcd-cam-mipi-dbi"

include: mipi-dbi-controller.yaml

properties:
  reset-gpios:
    type: phandle-array
    description: Optional GPIO connected to the panel reset line.

  cs-gpios:
    type: phandle-array
    description: Optional GPIO used to control the panel chip-select line.

  rd-gpios:
    type: phandle-array
    description: |
      Optional GPIO connected to the panel read-strobe (RD) line. In 8080
      write-only operation the panel still requires RD held inactive (high),
      otherwise it keeps driving the shared data bus and contends with the
      controller. Configured as an output and driven inactive at init.

child-binding:
  description: Configuration for display connected to the controller
  properties:
    dc-idle-level:
      type: int
      enum: [0, 1]
      description: Physical level on the DC line for idle phase.
      default: 0

    dc-cmd-level:
      type: int
      enum: [0, 1]
      description: Physical level on the DC line for command phase.
      default: 0

    dc-dummy-level:
      type: int
      enum: [0, 1]
      description: Physical level on the DC line for dummy phase.
      default: 0

    dc-data-level:
      type: int
      enum: [0, 1]
      description: Physical level on the DC line for data phase.
      default: 1
```

## dts/bindings/mipi-dbi/espressif,mipi-dbi-lcd.yaml
```yaml
description: |
  MIPI-DBI Mode B (Intel 8080) compatible for the ESP LCD peripheral.

compatible: "espressif,esp-mipi-dbi-lcd"

include : ["base.yaml", "pinctrl-device.yaml", "mipi-dbi-controller.yaml"]

properties:

  lcd-clock:
    type: int
    required: true
    description: |
      The clock frequency for the display. Check
      hal/espressif/components/soc/{esp board}/include/soc/clk_tree_defs.h

  bus-width:
    type: int
    required: true
    enum: [8, 16]
    description: |
      The bus width of the display. Can be either 8 or 16 bits.

  dc-gpios:
    type: phandle-array
    required: true
    description: |
      Data/command GPIO pin. Set to low when sending a command, or high when sending data.

  reset-gpios:
    type: phandle-array
    required: true
    description: |
      Reset GPIO pin. Set high to reset the display.

  rd-gpios:
    type: phandle-array
    required: true
    description: |
      Read GPIO pin. Set high when reading from the display.

  wr-gpios:
    type: phandle-array
    required: true
    description: |
      Write GPIO pin for type B (Intel 8080) mode.

  cs-gpios:
    type: phandle-array
    required: true
    description: |
      Chip-select GPIO pin.

  data-gpios:
    type: phandle-array
    required: true
    description: |
      GPIO pins used for the parallel data bus. This must have as many entries as the bus is wide
      of the selected mipi-mode.

  dmas:
    type: phandle-array
    description: |
      DMA channel to use for large data transfers. If not specified, the driver will use
      polling-based transfers.

  dma-names:
    type: string-array
    description: |
      Names for the DMA channels. Should be "tx" for transmit channel.
```
